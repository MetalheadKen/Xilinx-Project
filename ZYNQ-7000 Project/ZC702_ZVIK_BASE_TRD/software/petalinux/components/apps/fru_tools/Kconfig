## ZYNQ-7000 Project/ZC702_ZVIK_BASE_TRD/software/petalinux/components/libs/misc/Kconfig.7
```kconfig
###############################################################################
# Please modify this file if you want to configure your own library.
# You can uncommon and/or change the following Kconfig elements.
###############################################################################


if ROOTFS_COMPONENT_LIBS_NAME_MISC
	config LIBS_MISC
		bool
		default y
		select ROOTFS_PACKAGES_LIBSTDCPLUSPLUS6
	comment "No additional options for MISC"

# 	config LIBS_MISC_OPTION0
#	bool "option0"
#	help
#	  Help text
endif
```
